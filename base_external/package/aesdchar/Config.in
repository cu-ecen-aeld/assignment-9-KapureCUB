## base_external/package/aesdchar/Config.in
```kconfig
config BR2_PACKAGE_AESDCHAR
	bool "aesdchar"
	depends on BR2_LINUX_KERNEL
	help
	  Includes the aesdchar kernel module based on circular buffer
```

## base_external/package/ldd/Config.in
```kconfig
config BR2_PACKAGE_LDD
	bool "ldd"
	help
	 Package to install scull, faulty and hello module to buildroot  
```
